## config/boards/shields/7pi/Kconfig.defconfig
```kconfig
# Copyright (c) 2020 The ZMK Contributors
# SPDX-License-Identifier: MIT

if SHIELD_20KEY_DONGLE

    config ZMK_KEYBOARD_NAME
        default "20"

    config ZMK_SPLIT_BLE_ROLE_CENTRAL
        default y
endif

if SHIELD_20KEY_DONGLE || SHIELD_20KEY

    config ZMK_SPLIT
        default y

endif
```

## config/boards/shields/7pi/Kconfig.shield
```kconfig
# Copyright (c) 2020 The ZMK Contributors
# SPDX-License-Identifier: MIT

config SHIELD_20KEY_DONGLE
	def_bool $(shields_list_contains,20key_dongle)

config SHIELD_20KEY
	def_bool $(shields_list_contains,20KEY)
```
